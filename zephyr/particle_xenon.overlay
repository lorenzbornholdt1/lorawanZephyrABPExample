&spi1 { /* feather SPI */
	compatible = "nordic,nrf-spim"; 
	status = "okay";
	sck-pin = <47>;
	mosi-pin = <45>;
	miso-pin = <46>;
	cs-gpios = <&gpio0 31 GPIO_ACTIVE_LOW>;

	lora: sx1276@0 {
		compatible = "semtech,sx1276";
		reg = <0>;
		label = "sx1276";
		reset-gpios = <&gpio0 30 (GPIO_PULL_UP | GPIO_ACTIVE_LOW)>;
		dio-gpios = <&gpio0 29 (GPIO_PULL_DOWN | GPIO_ACTIVE_HIGH)>,
			<&gpio0 28 (GPIO_PULL_DOWN | GPIO_ACTIVE_HIGH)>,
			<&gpio0 4 (GPIO_PULL_DOWN | GPIO_ACTIVE_HIGH)>,
			<&gpio0 3 (GPIO_PULL_DOWN | GPIO_ACTIVE_HIGH)>,
			<&gpio1 10 (GPIO_PULL_DOWN | GPIO_ACTIVE_HIGH)>,
			<&gpio1 09 (GPIO_PULL_DOWN | GPIO_ACTIVE_HIGH)>;
		spi-max-frequency = <1000000>;
		power-amplifier-output = "pa-boost";
	};
};


/ {
     aliases {
             lora0 = &lora;
     };
};
